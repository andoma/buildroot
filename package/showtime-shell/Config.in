## package/showtime-shell/Config.in
```kconfig
config BR2_PACKAGE_SHOWTIME_SHELL
	bool "showtime-shell"
	help
	  Showtime launcher

	  https://github.com/andoma/showtime-shell
```

## package/stos-splash/Config.in
```kconfig
config BR2_PACKAGE_STOS_SPLASH
	bool "stos-splash"
	depends on BR2_PACKAGE_HAS_LIBGLES
        depends on BR2_PACKAGE_HAS_LIBEGL

	help
	  On screen info during boot

	  https://github.com/andoma/stos-splash
```
